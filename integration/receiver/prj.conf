## CMakeLists.txt
```
#
# Copyright (c) 2018 Nordic Semiconductor
#
# SPDX-License-Identifier: LicenseRef-Nordic-5-Clause
#
cmake_minimum_required(VERSION 3.20.0)

# Configure build metadata from git (best-effort)
find_package(Git)

if(GIT_EXECUTABLE)
  execute_process(
    COMMAND ${GIT_EXECUTABLE} branch --show-current
    WORKING_DIRECTORY ${CMAKE_SOURCE_DIR}
    OUTPUT_VARIABLE GIT_BRANCH
    )
  # Prefer a https URL for display (falls back to 'unknown')
  execute_process(
    COMMAND ${GIT_EXECUTABLE} config --get remote.origin.url
    WORKING_DIRECTORY ${CMAKE_SOURCE_DIR}
    OUTPUT_VARIABLE GIT_REPO_URL_SSH
    )
  execute_process(
    COMMAND ${GIT_EXECUTABLE} config --get remote.origin.https.url
    WORKING_DIRECTORY ${CMAKE_SOURCE_DIR}
    OUTPUT_VARIABLE GIT_REPO_URL_HTTPS
    )
  execute_process(
    COMMAND ${GIT_EXECUTABLE} log -1 --pretty=%an
    WORKING_DIRECTORY ${CMAKE_SOURCE_DIR}
    OUTPUT_VARIABLE GIT_AUTHOR
    )
endif()

if(GIT_BRANCH STREQUAL "")
  set(GIT_BRANCH unknown)
  message(WARNING "Unknown Git Branch")
endif()
# Choose URL: origin.https.url > origin.url
if(NOT GIT_REPO_URL_HTTPS STREQUAL "")
  set(GIT_REPO_URL ${GIT_REPO_URL_HTTPS})
else()
  set(GIT_REPO_URL ${GIT_REPO_URL_SSH})
endif()

# Normalize GitHub SSH URLs to HTTPS for display in firmware info
if(GIT_REPO_URL MATCHES "^git@github\\.com:(.+)$")
  set(GIT_REPO_URL "https://github.com/${CMAKE_MATCH_1}")
elseif(GIT_REPO_URL MATCHES "^ssh://git@github\\.com/(.+)$")
  set(GIT_REPO_URL "https://github.com/${CMAKE_MATCH_1}")
endif()
string(REGEX REPLACE "\\.git$" "" GIT_REPO_URL "${GIT_REPO_URL}")

if(GIT_REPO_URL STREQUAL "")
  set(GIT_REPO_URL unknown)
  message(WARNING "Unknown Git Repo URL")
endif()
if(GIT_AUTHOR STREQUAL "")
  set(GIT_AUTHOR unknown)
  message(WARNING "Unknown Git Author")
endif()
if(GIT_BRANCH STREQUAL "")
  set(GIT_BRANCH unknown)
  message(WARNING "Unknown Git Branch")
endif()

include(${CMAKE_CURRENT_SOURCE_DIR}/cmake/display_metadata.cmake)
sanitize_display_metadata()

# Pass metadata to C compilation units
add_compile_definitions(
  FW_GIT_BRANCH="${GIT_BRANCH}"
  FW_GIT_REPO_URL="${GIT_REPO_URL}"
  FW_GIT_AUTHOR="${GIT_AUTHOR}"
)

set(SLIMEVR_RECEIVER_HID_OVERLAY ${CMAKE_CURRENT_SOURCE_DIR}/boards/receiver_hid.overlay)
set(SLIMEVR_RECEIVER_ENTROPY_OVERLAY ${CMAKE_CURRENT_SOURCE_DIR}/boards/receiver_entropy.overlay)

if(DEFINED EXTRA_DTC_OVERLAY_FILE)
  set(EXTRA_DTC_OVERLAY_FILE ${SLIMEVR_RECEIVER_HID_OVERLAY} ${EXTRA_DTC_OVERLAY_FILE} ${SLIMEVR_RECEIVER_ENTROPY_OVERLAY})
else()
  set(EXTRA_DTC_OVERLAY_FILE ${SLIMEVR_RECEIVER_HID_OVERLAY} ${SLIMEVR_RECEIVER_ENTROPY_OVERLAY})
endif()

find_package(Zephyr REQUIRED HINTS $ENV{ZEPHYR_BASE})
project(NONE)
zephyr_get(ARC8_BUILD_ID SYSBUILD LOCAL)
if(DEFINED ARC8_BUILD_ID)
  if(NOT ARC8_BUILD_ID MATCHES "^[a-zA-Z0-9_-]+$")
    message(FATAL_ERROR "Invalid ARC8_BUILD_ID")
  endif()
  target_compile_definitions(app PRIVATE ARC8_BUILD_ID=${ARC8_BUILD_ID})
endif()

FILE(GLOB_RECURSE app_sources CONFIGURE_DEPENDS src/*.c)
# Data collection: choose HID or CDC implementation, or exclude both
if(CONFIG_DATA_COLLECT)
  if(CONFIG_DATA_COLLECT_HID)
    # HID mode: exclude CDC implementation
    list(FILTER app_sources EXCLUDE REGEX ".*data_collect\\.c$")
  else()
    # CDC mode: exclude HID implementation
    list(FILTER app_sources EXCLUDE REGEX ".*data_collect_hid\\.c$")
  endif()
else()
  # No data collection: exclude both
  list(FILTER app_sources EXCLUDE REGEX ".*data_collect.*\\.c$")
endif()
# NORDIC SDK APP START
target_sources(app PRIVATE ${app_sources})
# NORDIC SDK APP END

target_include_directories(app PRIVATE src)

# Force recompile for updated build timestamp
add_custom_target(touch_util_h ALL
    COMMAND ${CMAKE_COMMAND} -E touch ${CMAKE_SOURCE_DIR}/src/build_defines.h
)
```

## Kconfig
```
#
# Copyright (c) 2020 Nordic Semiconductor
#
# SPDX-License-Identifier: LicenseRef-Nordic-5-Clause
#

choice
	prompt "Status LED color mapping"
    default LED_TRI_COLOR

config LED_RGB_COLOR
    bool "Use RGB color mapping"
    help
        Use RGB or RG color mapping for LED status if available.

config LED_TRI_COLOR
    bool "Use default color mapping"
    help
        Use the default color mapping for LED status.

endchoice

menu "Status LED default status color"
    depends on LED_RGB_COLOR

config LED_DEFAULT_COLOR_R
    int "Red value"
    range 0 10000
    default 4000
    depends on LED_RGB_COLOR
    help
        Red color for default status.
        Valid range is 0 to 10000.

config LED_DEFAULT_COLOR_G
    int "Green value"
    range 0 10000
    default 6000
    depends on LED_RGB_COLOR
    help
        Green color for default status.
        Valid range is 0 to 10000.

config LED_DEFAULT_COLOR_B
    int "Blue value"
    range 0 10000
    default 0
    depends on LED_RGB_COLOR
    help
        Blue color for default status.
        Valid range is 0 to 10000.

endmenu

config RADIO_TX_POWER
    int "Radio output power (dBm)"
    default 30
    help
        Radio output power level.
        A lower value may reduce power consumption.

config RADIO_RF_CHANNEL
    int "Radio RF channel"
    default 2
    help
        Radio RF channel (0-100).
        Must match the receiver channel.

config RADIO_AUTO_CHANNEL
    bool "Loss-triggered runtime receiver channel avoidance"
    default y
    select ENTROPY_GENERATOR
    help
        Compile automatic avoidance support; runtime starts disabled on every
        boot. Explicit channelauto on enables it until reboot.
        Exchange short no-ACK identity beacons on the working channel
        every 2-4 seconds. A full 10-second normal sequence-loss window
        with at least 100 inferred frames and strictly more than 20% loss starts
        a distributed energy survey and finalist confirmation. Choose only
        even channels 0-88 with strictly quieter accepted peak energy than
        HOME; ties and incomplete coverage do not move. Matched paired-address
        activity rejects a visit. Known peer channels are excluded; HOME-only
        beacons do not negotiate destinations or prove other channels vacant.
        No observed peer is required for one trial migration. After a
        successful move and original-roster recovery, a fresh window on a
        stable receiver layout with persistent >20% loss stops automatic
        radio actions and suggests possible host USB/RF
        interference: use an extension cable and move away from the host.
        Explicit channelauto on or reboot clears the persistent-loss stop;
        reboot leaves avoidance disabled.
        Manual settings retain range 0-100; candidate channel 90 is excluded.
        Defers during pairing, OTA, raw capture and channel operations.
        Test-all suspends loss scans; working-channel beacons continue.
        A manual override disables avoidance until explicit channelauto on.

config RADIO_RETRANSMIT_DELAY
    int "Radio retransmit delay (µs)"
    default 600
    help
        Radio retransmit delay.

config PAIRING_TIMEOUT
    int "Pairing mode timeout (seconds)"
    default 300
    help
        Timeout for pairing mode in seconds.
        After this time, pairing mode will automatically exit.
        Default is 300 seconds (5 minutes).
        Set to 0 to disable timeout.

config ARC8_JOINT10_TRACE
    bool "ARC8 Joint10 Tracker 13 receiver command-path counters"
    default n
    help
        Diagnostic only. Counts queued commands, constructed radio ACKs and
        matching Tracker PING echoes. Does not change OTA, ESB or HID wire format.
        Use the console command joint10trace for a read-only snapshot.

config DATA_COLLECT
    bool "Enable raw sensor data collection interface"
    default n
    help
        Enable streaming raw IMU and magnetometer data from trackers.
        Choose HID or CDC transport via DATA_COLLECT_HID.

config DATA_COLLECT_HID
    bool "Use HID endpoint for data collection (instead of CDC serial)"
    depends on DATA_COLLECT
    default y
    help
        When enabled, raw data is sent via a dedicated HID endpoint.
        When disabled, raw data is sent via a second CDC ACM serial port.

config SLIMEVR_USB_DEVICE_VID
    hex "SlimeVR USB vendor ID"
    default 0x1209
    help
        USB vendor ID used by the SlimeVR USBD_NEXT device.

config SLIMEVR_USB_DEVICE_PID
    hex "SlimeVR USB product ID"
    default 0x7690
    help
        USB product ID used by the SlimeVR receiver firmware.

config SLIMEVR_USB_DEVICE_MANUFACTURER
    string "SlimeVR USB manufacturer"
    default "SlimeVR"
    help
        USB manufacturer string and console banner prefix.

config SLIMEVR_USB_DEVICE_PRODUCT
    string "SlimeVR USB product"
    default "SlimeNRF Receiver"
    help
        USB product string and console banner name.

config SLIMEVR_USB_DEVICE_MAX_POWER
    int "SlimeVR USB max power"
    range 0 250
    default 100
    help
        USB bMaxPower value in 2 mA units.

menu "TDMA diagnostics"

config TDMA_DIAGNOSTICS
    bool "Compile in TDMA/RF phase diagnostics"
    default n
    help
        Per-tracker phase/RSSI histograms, arrival phase checks, PING
        bias/skew and rejection tracking, the TDMA Stats phase warning,
        and the console health snapshot.
        Disable for production builds to remove diagnostic timestamps,
        phase accounting and warning calculations from the radio paths.
        TDMA scheduling, membership, loss control, PING/PONG clock sync
        and ordinary packet statistics stay functional without this
        option; only measurement instrumentation is removed.

endmenu

source "Kconfig.zephyr"
```

## Kconfig.sysbuild
```
config PARTITION_MANAGER
	default n

source "share/sysbuild/Kconfig"
```

## sample.yaml
```
tests:
  common:
    platform_allow:
      - nrf21540dk/nrf52840
      - nrf52840dk/nrf52840
      - nrf52840dongle/nrf52840
      - xiao_ble/nrf52840
    sysbuild: true
```

## west.yml
```
manifest:
  version: "1.2"
  projects:

    # nRF-Connect SDK
    - name: sdk-nrf
      path: nrf
      url: https://github.com/jitingcn/sdk-nrf.git
      revision: ecf4e4df5a883e29dce154d63de6f12577adaa42
      import: true
```

## prj.conf
```kconfig
#CONFIG_NCS_SAMPLES_DEFAULTS
CONFIG_ASSERT=y
CONFIG_ASSERT_NO_COND_INFO=y
CONFIG_ASSERT_NO_MSG_INFO=y
CONFIG_RESET_ON_FATAL_ERROR=n
CONFIG_REBOOT=y

CONFIG_NCS_APPLICATION_BOOT_BANNER_STRING="SlimeVR-Tracker-nRF-Receiver"
#CONFIG_NCS_BOOT_BANNER=n
CONFIG_BOOT_BANNER=n

# HEX carries mapped-partition addresses for native UF2 generation.
CONFIG_BUILD_OUTPUT_HEX=y

CONFIG_ESB=y
CONFIG_PICOLIBC=y
CONFIG_CBPRINTF_FP_SUPPORT=y

CONFIG_FPU=y

CONFIG_USB_DEVICE_STACK_NEXT=y
CONFIG_USBD_HID_SUPPORT=y
CONFIG_USBD_CDC_ACM_CLASS=y
CONFIG_CDC_ACM_SERIAL_INITIALIZE_AT_BOOT=n
CONFIG_SLIMEVR_USB_DEVICE_VID=0x1209
CONFIG_SLIMEVR_USB_DEVICE_PID=0x7690
CONFIG_UART_INTERRUPT_DRIVEN=y
#CONFIG_USB_WORKQUEUE_STACK_SIZE=512

CONFIG_SERIAL=y
CONFIG_CONSOLE=y
CONFIG_UART_CONSOLE=y
CONFIG_UART_LINE_CTRL=y

CONFIG_USE_SEGGER_RTT=y
CONFIG_LOG=y
#CONFIG_PRINTK=y
CONFIG_LOG_MODE_DEFERRED=y
CONFIG_LOG_SPEED=y
CONFIG_LOG_BACKEND_RTT=y
CONFIG_USBD_LOG_LEVEL_WRN=y
CONFIG_UDC_DRIVER_LOG_LEVEL_WRN=y
CONFIG_USBD_CDC_ACM_LOG_LEVEL_OFF=y
CONFIG_UDC_BUF_POOL_SIZE=4096
CONFIG_LOG_BUFFER_SIZE=4096
CONFIG_LOG_PROCESS_THREAD_SLEEP_MS=100
CONFIG_LOG_PROCESS_THREAD_STACK_SIZE=1024
CONFIG_LOG_PROCESS_THREAD_STARTUP_DELAY_MS=0

CONFIG_LOG_BACKEND_UART=y
CONFIG_LOG_BACKEND_UART_AUTOSTART=n
CONFIG_LOG_MODE_DEFERRED=y

CONFIG_CONSOLE_SUBSYS=y

CONFIG_NVS_LOG_LEVEL_WRN=y
CONFIG_USBD_HID_LOG_LEVEL_WRN=y

CONFIG_USBD_HID_IN_BUF_COUNT=4
CONFIG_USBD_HID_OUT_BUF_COUNT=4

CONFIG_GPIO=y
CONFIG_PWM=y

CONFIG_NVS=y

CONFIG_FLASH=y
CONFIG_FLASH_PAGE_LAYOUT=y
CONFIG_FLASH_MAP=y
CONFIG_USE_DT_CODE_PARTITION=y

CONFIG_SETTINGS=y
CONFIG_SETTINGS_NVS=y
CONFIG_SETTINGS_RUNTIME=y
CONFIG_SETTINGS_NONE=y

CONFIG_MPU_ALLOW_FLASH_WRITE=y

CONFIG_NVS_LOOKUP_CACHE=y

CONFIG_ESB_MAX_PAYLOAD_LENGTH=72
CONFIG_ESB_TX_FIFO_SIZE=16
CONFIG_ESB_RX_FIFO_SIZE=16
# CONFIG_NRFX_TIMER1=y

#speed up boot? (use internal rc oscillator)
#CONFIG_CLOCK_CONTROL_NRF_K32SRC_RC=y
#speed up boot? (synthesize lf clock)
CONFIG_CLOCK_CONTROL_NRF_K32SRC_SYNTH=y

# dont need it
CONFIG_CRYPTO=n

CONFIG_THREAD_NAME=y
CONFIG_SYSTEM_WORKQUEUE_STACK_SIZE=2048
CONFIG_MAIN_STACK_SIZE=2048

#CONFIG_HEAP_MEM_POOL_SIZE=2048
CONFIG_ISR_STACK_SIZE=1024

CONFIG_RADIO_RF_CHANNEL=84
CONFIG_RADIO_RETRANSMIT_DELAY=310
CONFIG_RADIO_TX_POWER=30

CONFIG_LTO=y
CONFIG_ISR_TABLES_LOCAL_DECLARATION=y
```

## sysbuild_mcuboot.conf
```kconfig
SB_CONFIG_PARTITION_MANAGER=n
SB_CONFIG_MERGED_HEX_FILES=y
SB_CONFIG_BOOTLOADER_MCUBOOT=y
SB_CONFIG_BOOT_SIGNATURE_TYPE_NONE=y
```

## boards/data_collect.conf
```kconfig
# Enable raw sensor data collection interface
CONFIG_DATA_COLLECT=y
# Use HID endpoint (set to n for CDC serial mode)
CONFIG_DATA_COLLECT_HID=y
```

## boards/data_collect_cdc.conf
```kconfig
# Enable raw sensor data collection via CDC serial port
CONFIG_DATA_COLLECT=y
CONFIG_DATA_COLLECT_HID=n
```

## boards/mcuboot.conf
```kconfig
CONFIG_IMG_MANAGER=y
CONFIG_STREAM_FLASH=y
CONFIG_RETAINED_MEM=y
CONFIG_RETENTION=y
CONFIG_RETENTION_BOOT_MODE=y
```

## boards/nrf21540dk_nrf52840.conf
```kconfig
CONFIG_SLIMEVR_USB_DEVICE_MANUFACTURER="Nordic Semiconductor"
CONFIG_SLIMEVR_USB_DEVICE_PRODUCT="SlimeNRF Receiver nRF21540 DK"
```

## boards/nrf52840dk_nrf52840.conf
```kconfig
CONFIG_SLIMEVR_USB_DEVICE_MANUFACTURER="Nordic Semiconductor"
CONFIG_SLIMEVR_USB_DEVICE_PRODUCT="SlimeNRF Receiver nRF52840 DK"
```

## boards/data_collect.overlay
```dts
/ {
	hid_dev_1: hid_dev_1 {
		compatible = "zephyr,hid-device";
		protocol-code = "none";
		in-report-size = <64>;
		in-polling-period-us = <1000>;
	};
};
```

## boards/data_collect_cdc.overlay
```dts
&zephyr_udc0 {
	cdc_acm_uart1: cdc_acm_uart1 {
		compatible = "zephyr,cdc-acm-uart";
		label = "SlimeNRF Raw Data CDC";
		tx-fifo-size = <4096>;
		rx-fifo-size = <64>;
	};
};
```

## boards/nrf21540dk_nrf52840.overlay
```dts
/ {
	chosen {
		zephyr,console = &cdc_acm_uart0;
		zephyr,shell-uart = &cdc_acm_uart0;
	};
};

zephyr_udc0: &usbd {
	cdc_acm_uart0: cdc_acm_uart0 {
		compatible = "zephyr,cdc-acm-uart";
	};
};
```

## boards/nrf52840dongle_nrf52840.overlay
```dts
&red_pwm_led {
	pwms = <&pwm0 0 PWM_MSEC(1) PWM_POLARITY_INVERTED>;
};
&green_pwm_led {
	pwms = <&pwm0 1 PWM_MSEC(1) PWM_POLARITY_INVERTED>;
};
&blue_pwm_led {
	pwms = <&pwm0 2 PWM_MSEC(1) PWM_POLARITY_INVERTED>;
};
```

## boards/receiver_entropy.overlay
```dts
/* ENTROPY_GENERATOR also enables Zephyr's chosen-device random backend.
 * nRF52833/840 receivers use their RNG, not disabled CryptoCell. */
/ {
	chosen {
		zephyr,entropy = &rng;
	};
};

&rng {
	status = "okay";
};
```

## boards/receiver_hid.overlay
```dts
/ {
	hid_dev_0: hid_dev_0 {
		compatible = "zephyr,hid-device";
		protocol-code = "none";
		in-report-size = <64>;
		in-polling-period-us = <1000>;
		out-report-size = <64>;
		out-polling-period-us = <1000>;
	};
};
```

## src/main.c
```c
/*
	SlimeVR Code is placed under the MIT license
	Copyright (c) 2025 SlimeVR Contributors

	Permission is hereby granted, free of charge, to any person obtaining a copy
	of this software and associated documentation files (the "Software"), to deal
	in the Software without restriction, including without limitation the rights
	to use, copy, modify, merge, publish, distribute, sublicense, and/or sell
	copies of the Software, and to permit persons to whom the Software is
	furnished to do so, subject to the following conditions:

	The above copyright notice and this permission notice shall be included in
	all copies or substantial portions of the Software.

	THE SOFTWARE IS PROVIDED "AS IS", WITHOUT WARRANTY OF ANY KIND, EXPRESS OR
	IMPLIED, INCLUDING BUT NOT LIMITED TO THE WARRANTIES OF MERCHANTABILITY,
	FITNESS FOR A PARTICULAR PURPOSE AND NONINFRINGEMENT. IN NO EVENT SHALL THE
	AUTHORS OR COPYRIGHT HOLDERS BE LIABLE FOR ANY CLAIM, DAMAGES OR OTHER
	LIABILITY, WHETHER IN AN ACTION OF CONTRACT, TORT OR OTHERWISE, ARISING FROM,
	OUT OF OR IN CONNECTION WITH THE SOFTWARE OR THE USE OR OTHER DEALINGS IN
	THE SOFTWARE.
*/
#include "globals.h"
#include "system/system.h"
#include "system/led.h"
#include "system/status.h"
#include "connection/esb.h"

#include <zephyr/kernel.h>
#include <zephyr/sys/reboot.h>
#if defined(CONFIG_BOOTLOADER_MCUBOOT)
#include <zephyr/dfu/mcuboot.h>
#endif

LOG_MODULE_REGISTER(main, LOG_LEVEL_INF);

static void boot_confirm_after_healthy_uptime(void)
{
#if defined(CONFIG_BOOTLOADER_MCUBOOT) || \
	(CONFIG_SOC_SERIES_NRF52 && CONFIG_BUILD_OUTPUT_UF2)
	int64_t remaining_ms = 60000 - k_uptime_get();
	if (remaining_ms > 0) {
		k_sleep(K_MSEC(remaining_ms));
	}
	sys_mark_boot_success();
#if defined(CONFIG_BOOTLOADER_MCUBOOT)
	if (!boot_is_img_confirmed()) {
		int err = boot_write_img_confirmed();
		if (err) {
			LOG_ERR("Failed to confirm MCUboot image: %d", err);
		} else {
			LOG_INF("MCUboot test image confirmed");
		}
	}
#endif
#endif
}

int main(void)
{
	// Initialize LED system first
	set_led(SYS_LED_PATTERN_ACTIVE_PERSIST, SYS_LED_PRIORITY_SYSTEM);

	// Boot sequence with button detection
	set_led(SYS_LED_PATTERN_ON, SYS_LED_PRIORITY_BOOT);

	// Check if button is pressed during boot
	if (button_read())
	{
		LOG_INF("Button detected during boot");
		int64_t boot_start = k_uptime_get();
		bool pairing_reset_saved = false;

		while (button_read())
		{
			if (k_uptime_get() - boot_start > 1000)
				set_led(SYS_LED_PATTERN_LONG, SYS_LED_PRIORITY_HIGHEST);
			if (k_uptime_get() - boot_start > 5000)
			{
				LOG_INF("Boot-time pairing reset requested");
				pairing_reset_saved = esb_clear() == 0;
				break;
			}
			k_msleep(10);
		}

		if (pairing_reset_saved)
			set_led(SYS_LED_PATTERN_ONESHOT_COMPLETE, SYS_LED_PRIORITY_HIGHEST);
		else if (k_uptime_get() - boot_start > 50) // Short press during boot
			set_led(SYS_LED_PATTERN_ONESHOT_POWERON, SYS_LED_PRIORITY_HIGHEST);
	}

	// Clear boot LED priority
	set_led(SYS_LED_PATTERN_OFF, SYS_LED_PRIORITY_BOOT);
	boot_confirm_after_healthy_uptime();

	return 0;
}
```

## src/build_defines.h
```c
/*
	SlimeVR Code is placed under the MIT license
	Copyright (c) 2025 SlimeVR Contributors

	Permission is hereby granted, free of charge, to any person obtaining a copy
	of this software and associated documentation files (the "Software"), to deal
	in the Software without restriction, including without limitation the rights
	to use, copy, modify, merge, publish, distribute, sublicense, and/or sell
	copies of the Software, and to permit persons to whom the Software is
	furnished to do so, subject to the following conditions:

	The above copyright notice and this permission notice shall be included in
	all copies or substantial portions of the Software.

	THE SOFTWARE IS PROVIDED "AS IS", WITHOUT WARRANTY OF ANY KIND, EXPRESS OR
	IMPLIED, INCLUDING BUT NOT LIMITED TO THE WARRANTIES OF MERCHANTABILITY,
	FITNESS FOR A PARTICULAR PURPOSE AND NONINFRINGEMENT. IN NO EVENT SHALL THE
	AUTHORS OR COPYRIGHT HOLDERS BE LIABLE FOR ANY CLAIM, DAMAGES OR OTHER
	LIABILITY, WHETHER IN AN ACTION OF CONTRACT, TORT OR OTHERWISE, ARISING FROM,
	OUT OF OR IN CONNECTION WITH THE SOFTWARE OR THE USE OR OTHER DEALINGS IN
	THE SOFTWARE.
*/
#include "app_version.h"
#ifdef ARC8_BUILD_ID
#undef APP_BUILD_VERSION
#define APP_BUILD_VERSION ARC8_BUILD_ID
#endif

#define FW_NAME CONFIG_NCS_APPLICATION_BOOT_BANNER_STRING
#define FW_VERSION_MAJOR APP_VERSION_MAJOR
#define FW_VERSION_MINOR APP_VERSION_MINOR
#define FW_VERSION_PATCH APP_PATCHLEVEL

// Build-time VCS metadata (injected by CMake). Keep safe fallbacks for non-git builds.
#ifndef FW_GIT_REPO_URL
#define FW_GIT_REPO_URL "unknown"
#endif
#ifndef FW_GIT_BRANCH
#define FW_GIT_BRANCH "unknown"
#endif
#ifndef FW_GIT_AUTHOR
#define FW_GIT_AUTHOR "unknown"
#endif

// https://stackoverflow.com/questions/11697820/how-to-use-date-and-time-predefined-macros-in-as-two-integers-then-stri
#define COMPUTE_BUILD_YEAR \
	( \
		(__DATE__[ 7] - '0') * 1000 + \
		(__DATE__[ 8] - '0') *  100 + \
		(__DATE__[ 9] - '0') *   10 + \
		(__DATE__[10] - '0') \
	)

#define COMPUTE_BUILD_DAY \
	( \
		((__DATE__[4] >= '0') ? (__DATE__[4] - '0') * 10 : 0) + \
		(__DATE__[5] - '0') \
	)

#define BUILD_MONTH_IS_JAN (__DATE__[0] == 'J' && __DATE__[1] == 'a' && __DATE__[2] == 'n')
#define BUILD_MONTH_IS_FEB (__DATE__[0] == 'F')
#define BUILD_MONTH_IS_MAR (__DATE__[0] == 'M' && __DATE__[1] == 'a' && __DATE__[2] == 'r')
#define BUILD_MONTH_IS_APR (__DATE__[0] == 'A' && __DATE__[1] == 'p')
#define BUILD_MONTH_IS_MAY (__DATE__[0] == 'M' && __DATE__[1] == 'a' && __DATE__[2] == 'y')
#define BUILD_MONTH_IS_JUN (__DATE__[0] == 'J' && __DATE__[1] == 'u' && __DATE__[2] == 'n')
#define BUILD_MONTH_IS_JUL (__DATE__[0] == 'J' && __DATE__[1] == 'u' && __DATE__[2] == 'l')
#define BUILD_MONTH_IS_AUG (__DATE__[0] == 'A' && __DATE__[1] == 'u')
#define BUILD_MONTH_IS_SEP (__DATE__[0] == 'S')
#define BUILD_MONTH_IS_OCT (__DATE__[0] == 'O')
#define BUILD_MONTH_IS_NOV (__DATE__[0] == 'N')
#define BUILD_MONTH_IS_DEC (__DATE__[0] == 'D')

#define COMPUTE_BUILD_MONTH \
	( \
		(BUILD_MONTH_IS_JAN) ?  1 : \
		(BUILD_MONTH_IS_FEB) ?  2 : \
		(BUILD_MONTH_IS_MAR) ?  3 : \
		(BUILD_MONTH_IS_APR) ?  4 : \
		(BUILD_MONTH_IS_MAY) ?  5 : \
		(BUILD_MONTH_IS_JUN) ?  6 : \
		(BUILD_MONTH_IS_JUL) ?  7 : \
		(BUILD_MONTH_IS_AUG) ?  8 : \
		(BUILD_MONTH_IS_SEP) ?  9 : \
		(BUILD_MONTH_IS_OCT) ? 10 : \
		(BUILD_MONTH_IS_NOV) ? 11 : \
		(BUILD_MONTH_IS_DEC) ? 12 : \
		/* error default */  99 \
	)

#define COMPUTE_BUILD_HOUR ((__TIME__[0] - '0') * 10 + __TIME__[1] - '0')
#define COMPUTE_BUILD_MIN  ((__TIME__[3] - '0') * 10 + __TIME__[4] - '0')
#define COMPUTE_BUILD_SEC  ((__TIME__[6] - '0') * 10 + __TIME__[7] - '0')

#define BUILD_DATE_IS_BAD (__DATE__[0] == '?')

#define BUILD_YEAR  ((BUILD_DATE_IS_BAD) ? 99 : COMPUTE_BUILD_YEAR)
#define BUILD_MONTH ((BUILD_DATE_IS_BAD) ? 99 : COMPUTE_BUILD_MONTH)
#define BUILD_DAY   ((BUILD_DATE_IS_BAD) ? 99 : COMPUTE_BUILD_DAY)

#define BUILD_TIME_IS_BAD (__TIME__[0] == '?')

#define BUILD_HOUR  ((BUILD_TIME_IS_BAD) ? 99 :  COMPUTE_BUILD_HOUR)
#define BUILD_MIN   ((BUILD_TIME_IS_BAD) ? 99 :  COMPUTE_BUILD_MIN)
#define BUILD_SEC   ((BUILD_TIME_IS_BAD) ? 99 :  COMPUTE_BUILD_SEC)

#define TOSTRING(x) STRINGIFY(x)

#define FW_STRING FW_NAME " " APP_VERSION_EXTENDED_STRING " "\
	"(Commit " TOSTRING(APP_BUILD_VERSION) ", Build %d-%02d-%02d %02d:%02d:%02d)\n",\
	BUILD_YEAR, BUILD_MONTH, BUILD_DAY, BUILD_HOUR, BUILD_MIN, BUILD_SEC
```

## src/calwire_relay.c
```c
#include "calwire_relay.h"
#include "calwire_protocol.h"
#include "globals.h"
#include "connection/esb.h"
#include "esb_ota.h"
#include "receiver_ota.h"
#include "data_collect.h"
#include <zephyr/kernel.h>
#include <zephyr/sys/printk.h>
#include <errno.h>
static uint8_t pending[48];
static bool active;
static uint32_t deadline;
K_MSGQ_DEFINE(cw_responses,48,4,4);
static int digit(char c){return c>='0'&&c<='9'?c-'0':c>='a'&&c<='f'?c-'a'+10:-1;}
int calwire_relay_submit(const char *hex){
    uint8_t p[48];if(!hex||strlen(hex)!=96)return -EINVAL;
    for(unsigned i=0;i<48;i++){int a=digit(hex[2*i]),b=digit(hex[2*i+1]);if(a<0||b<0)return -EINVAL;p[i]=(a<<4)|b;}
    if(!cw_valid(p,48,0x26))return -EINVAL;
    if(esb_ota_relay_is_active()||receiver_ota_is_active()||esb_channel_is_busy()||
       data_collect_is_active()||data_collect_batch_is_active())return -EBUSY;
    unsigned key=irq_lock();
    if(p[1]>=stored_trackers||memcmp(&stored_tracker_addr[p[1]],p+8,6)){
        irq_unlock(key);return -ENOENT;
    }
    if(active&&(int32_t)(k_uptime_get_32()-deadline)<0&&memcmp(p,pending,48)){
        irq_unlock(key);return -EBUSY;
    }
    memcpy(pending,p,48);deadline=k_uptime_get_32()+3000;active=true;
    irq_unlock(key);return 0;
}
bool calwire_relay_ack(uint8_t slot,uint8_t out[48]){
    unsigned key=irq_lock();
    bool ok=active&&(int32_t)(k_uptime_get_32()-deadline)<0&&pending[1]==slot&&
        slot<stored_trackers&&!memcmp(&stored_tracker_addr[slot],pending+8,6);
    if(ok)memcpy(out,pending,48);
    irq_unlock(key);return ok;
}
void calwire_relay_receive(const uint8_t *p,size_t n){
    if(!cw_valid(p,n,0x27))return;
    unsigned key=irq_lock();
    bool match=active&&p[1]==pending[1]&&p[3]==pending[3]&&!memcmp(p+4,pending+4,12)&&
        p[16]>=4&&!memcmp(p+18,pending+44,4);
    if(match){
        /* Keep pending if the USB response queue is full; host retries. */
        if(!k_msgq_put(&cw_responses,p,K_NO_WAIT))active=false;
    }
    irq_unlock(key);
}
static void worker(void){
    uint8_t p[48];char hex[97];static const char chars[]="0123456789abcdef";
    while(true){
        k_msgq_get(&cw_responses,p,K_FOREVER);
        for(unsigned i=0;i<48;i++){hex[2*i]=chars[p[i]>>4];hex[2*i+1]=chars[p[i]&15];}
        hex[96]=0;printk("CALWIRE %s\n",hex);
    }
}
K_THREAD_DEFINE(calwire_relay_thread,1024,worker,NULL,NULL,NULL,7,0,0);
```

## src/calwire_relay.h
```c
#ifndef CALWIRE_RELAY_H
#define CALWIRE_RELAY_H
#include <stdbool.h>
#include <stddef.h>
#include <stdint.h>
int calwire_relay_submit(const char *hex);
bool calwire_relay_ack(uint8_t slot,uint8_t out[48]);
void calwire_relay_receive(const uint8_t *p,size_t n);
#endif
```

## src/console.h
```c
#ifndef SLIMENRF_RECEIVER_CONSOLE_H
#define SLIMENRF_RECEIVER_CONSOLE_H

void console_serial_start(void);
/* DTR close: discard incomplete input, retaining accepted complete commands. */
void console_serial_close(void);
/* USB teardown: also invalidate queued and dequeued commands not yet admitted. */
void console_serial_stop(void);

#endif
```

## src/console_send.h
```c
/*
	SlimeVR Code is placed under the MIT license
	Copyright (c) 2025 SlimeVR Contributors

	Permission is hereby granted, free of charge, to any person obtaining a copy
	of this software and associated documentation files (the "Software"), to deal
	in the Software without restriction, including without limitation the rights
	to use, copy, modify, merge, publish, distribute, sublicense, and/or sell
	copies of the Software, and to permit persons to whom the Software is
	furnished to do so, subject to the following conditions:

	The above copyright notice and this permission notice shall be included in
	all copies or substantial portions of the Software.

	THE SOFTWARE IS PROVIDED "AS IS", WITHOUT WARRANTY OF ANY KIND, EXPRESS OR
	IMPLIED, INCLUDING BUT NOT LIMITED TO THE WARRANTIES OF MERCHANTABILITY,
	FITNESS FOR A PARTICULAR PURPOSE AND NONINFRINGEMENT. IN NO EVENT SHALL THE
	AUTHORS OR COPYRIGHT HOLDERS BE LIABLE FOR ANY CLAIM, DAMAGES OR OTHER
	LIABILITY, WHETHER IN AN ACTION OF CONTRACT, TORT OR OTHERWISE, ARISING FROM,
	OUT OF OR IN CONNECTION WITH THE SOFTWARE OR THE USE OR OTHER DEALINGS IN
	THE SOFTWARE.
*/
#ifndef SLIMENRF_CONSOLE_SEND_H
#define SLIMENRF_CONSOLE_SEND_H

void console_handle_send(char *arg, char *arg2, char *arg3, char *arg4, char *arg5, char *arg6);

#endif
```

## src/data_collect.c
```c
/*
	SlimeVR Code is placed under the MIT license
	Copyright (c) 2025 SlimeVR Contributors

	Permission is hereby granted, free of charge, to any person obtaining a copy
	of this software and associated documentation files (the "Software"), to deal
	in the Software without restriction, including without limitation the rights
	to use, copy, modify, merge, publish, distribute, sublicense, and/or sell
	copies of the Software, and to permit persons to whom the Software is
	furnished to do so, subject to the following conditions:

	The above copyright notice and this permission notice shall be included in
	all copies or substantial portions of the Software.

	THE SOFTWARE IS PROVIDED "AS IS", WITHOUT WARRANTY OF ANY KIND, EXPRESS OR
	IMPLIED, INCLUDING BUT NOT LIMITED TO THE WARRANTIES OF MERCHANTABILITY,
	FITNESS FOR A PARTICULAR PURPOSE AND NONINFRINGEMENT. IN NO EVENT SHALL THE
	AUTHORS OR COPYRIGHT HOLDERS BE LIABLE FOR ANY CLAIM, DAMAGES OR OTHER
	LIABILITY, WHETHER IN AN ACTION OF CONTRACT, TORT OR OTHERWISE, ARISING FROM,
	OUT OF OR IN CONNECTION WITH THE SOFTWARE OR THE USE OR OTHER DEALINGS IN
	THE SOFTWARE.
*/

#include "data_collect.h"
#include "connection/esb.h"
#include "globals.h"

#include <zephyr/kernel.h>
#include <zephyr/device.h>
#include <zephyr/drivers/uart.h>
#include <zephyr/sys/byteorder.h>
#include <zephyr/sys/crc.h>
#include <zephyr/logging/log.h>

LOG_MODULE_REGISTER(data_collect, LOG_LEVEL_INF);

/* Dedicated CDC ACM UART device for data collection (separate from console) */
static const struct device *cdc_dev;
static bool cdc_ready;

/* Ring buffer for CDC output to decouple ISR-context writes from USB.
 * 16 KB holds ~284 frames (57 bytes each) ≈ 716 ms at 400 Hz. */
#define DATA_COLLECT_BUF_SIZE 16384
static uint8_t dc_buf[DATA_COLLECT_BUF_SIZE];
static volatile uint32_t dc_buf_head;
static volatile uint32_t dc_buf_tail;

/* Statistics */
static uint32_t dc_frames_sent;
static uint32_t dc_frames_dropped;

/* Runtime state */
static bool dc_active;
static uint8_t dc_target_tracker_id;
static bool dc_batch_active;
static uint32_t dc_batch_mask;

/* Timeout: auto-stop if no raw data received for this long */
#define DC_TIMEOUT_MS 60000
static int64_t dc_last_rx_time;

static inline uint32_t buf_used(void)
{
	int32_t diff = (int32_t)dc_buf_head - (int32_t)dc_buf_tail;
	if (diff < 0) diff += DATA_COLLECT_BUF_SIZE;
	return (uint32_t)diff;
}

static inline uint32_t buf_free(void)
{
	return DATA_COLLECT_BUF_SIZE - 1 - buf_used();
}

static void buf_put(uint8_t byte)
{
	dc_buf[dc_buf_head] = byte;
	dc_buf_head = (dc_buf_head + 1) % DATA_COLLECT_BUF_SIZE;
}

static bool cdc_host_is_open(void)
{
	uint32_t dtr = 0;

	return cdc_dev != NULL &&
	       uart_line_ctrl_get(cdc_dev, UART_LINE_CTRL_DTR, &dtr) == 0 &&
	       dtr != 0;
}

static void dc_discard_buffer(void)
{
	dc_buf_tail = dc_buf_head;
}

static uint32_t dc_contiguous_len(void)
{
	uint32_t head = dc_buf_head;
	uint32_t tail = dc_buf_tail;

	if (tail == head) {
		return 0;
	}

	if (tail < head) {
		return head - tail;
	}

	return DATA_COLLECT_BUF_SIZE - tail;
}

static void dc_tx_kick_work_handler(struct k_work *work);
static K_WORK_DELAYABLE_DEFINE(dc_tx_kick_work, dc_tx_kick_work_handler);

/* IRQ callbacks and producer kicks may run on different workqueues. Disable
 * first, then recheck: a producer before the disable must not lose its enable.
 * A producer after the recheck schedules its own kick.
 */
static void dc_tx_pause(const struct device *dev)
{
	uart_irq_tx_disable(dev);
	if (dc_buf_tail != dc_buf_head) {
		k_work_schedule(&dc_tx_kick_work, K_MSEC(1));
	}
}

static void dc_uart_irq_callback(const struct device *dev, void *user_data)
{
	ARG_UNUSED(user_data);

	if (dev != cdc_dev) {
		return;
	}

	while (uart_irq_update(dev) && uart_irq_is_pending(dev)) {
		if (!uart_irq_tx_ready(dev)) {
			continue;
		}

		if (!cdc_host_is_open()) {
			dc_discard_buffer();
			dc_tx_pause(dev);
			continue;
		}

		uint32_t len = dc_contiguous_len();
		if (len == 0) {
			dc_tx_pause(dev);
			continue;
		}

		int sent = uart_fifo_fill(dev, &dc_buf[dc_buf_tail], len);
		if (sent <= 0) {
			dc_tx_pause(dev);
			continue;
		}

		dc_buf_tail = (dc_buf_tail + (uint32_t)sent) % DATA_COLLECT_BUF_SIZE;
		if (dc_buf_tail == dc_buf_head) {
			dc_tx_pause(dev);
		}
	}
}

static void dc_tx_kick_work_handler(struct k_work *work)
{
	ARG_UNUSED(work);

	if (!cdc_dev) {
		return;
	}

	if (!cdc_host_is_open()) {
		dc_discard_buffer();
		return;
	}

	if (dc_buf_tail != dc_buf_head) {
		uart_irq_tx_enable(cdc_dev);
		/* The CDC driver normally advances TX from completion/enable/resume.
		 * Keep a bounded fallback only while app bytes remain: FIFO-full can
		 * suppress callbacks, including observation of DTR closing.
		 */
		if (dc_buf_tail != dc_buf_head) {
			k_work_schedule(&dc_tx_kick_work, K_MSEC(1));
		}
	}
}

static void dc_timer_handler(struct k_timer *timer);
static K_TIMER_DEFINE(dc_timer, dc_timer_handler, NULL);

/* Timeout work: stop collection and notify tracker (runs in workqueue context) */
static void dc_timeout_work_handler(struct k_work *work);
static K_WORK_DEFINE(dc_timeout_work, dc_timeout_work_handler);

static void dc_timeout_work_handler(struct k_work *work)
{
	ARG_UNUSED(work);
	if (!dc_active && !dc_batch_active) {
		return;
	}
	if (dc_batch_active) {
		uint32_t mask = dc_batch_mask;
		data_collect_batch_stop();
		for (uint8_t tid = 0; tid < MAX_TRACKERS; tid++) {
			if (mask & BIT(tid)) {
				esb_send_remote_command(tid, ESB_PONG_FLAG_DATA_COLLECT_BATCH_OFF);
			}
		}
		LOG_WRN("Batch data collection timed out (no data for %d s), sent OFF to trackers 0x%08x",
			DC_TIMEOUT_MS / 1000, (unsigned int)mask);
		return;
	}
	uint8_t tid = dc_target_tracker_id;
	data_collect_stop();
	esb_send_remote_command(tid, ESB_PONG_FLAG_DATA_COLLECT_OFF);
	LOG_WRN("Data collection timed out (no data for %d s), sent OFF to tracker %u",
		DC_TIMEOUT_MS / 1000, tid);
}

static void dc_timer_handler(struct k_timer *timer)
{
	ARG_UNUSED(timer);

	/* Check for data collection timeout */
	if ((dc_active || dc_batch_active) && dc_last_rx_time > 0 &&
	    (k_uptime_get() - dc_last_rx_time) > DC_TIMEOUT_MS) {
		k_work_submit(&dc_timeout_work);
	}
}

int data_collect_init(void)
{
	/* Get the dedicated data-collection CDC ACM device */
	cdc_dev = DEVICE_DT_GET(DT_NODELABEL(cdc_acm_uart1));
	if (!device_is_ready(cdc_dev)) {
		LOG_ERR("CDC ACM device not ready");
		return -ENODEV;
	}

	int ret = uart_irq_callback_user_data_set(cdc_dev, dc_uart_irq_callback, NULL);
	if (ret != 0) {
		LOG_ERR("Failed to set CDC ACM IRQ callback: %d", ret);
		return ret;
	}

	cdc_ready = true;
	dc_active = false;
	dc_batch_active = false;
	dc_batch_mask = 0;
	k_timer_start(&dc_timer, K_SECONDS(1), K_SECONDS(1));

	LOG_INF("Data collection subsystem initialized");
	return 0;
}

void data_collect_start(uint8_t tracker_id)
{
	dc_batch_active = false;
	dc_batch_mask = 0;
	dc_target_tracker_id = tracker_id;
	dc_active = true;
	dc_frames_sent = 0;
	dc_frames_dropped = 0;
	dc_last_rx_time = k_uptime_get();
	LOG_INF("Data collection STARTED for tracker %u", tracker_id);
}

void data_collect_stop(void)
{
	dc_active = false;
	LOG_INF("Data collection STOPPED (sent: %u, dropped: %u)",
		dc_frames_sent, dc_frames_dropped);
}

void data_collect_batch_start(uint32_t mask, uint16_t rate_hz)
{
	dc_active = false;
	dc_batch_mask = mask;
	dc_batch_active = mask != 0;
	dc_frames_sent = 0;
	dc_frames_dropped = 0;
	dc_last_rx_time = k_uptime_get();
	LOG_INF("Batch data collection STARTED mask=0x%08x rate=%u Hz",
		(unsigned int)mask, rate_hz);
}

void data_collect_batch_stop(void)
{
	dc_batch_active = false;
	dc_batch_mask = 0;
	LOG_INF("Batch data collection STOPPED (sent: %u, dropped: %u)",
		dc_frames_sent, dc_frames_dropped);
}

void data_collect_forget_tracker(uint8_t tracker_id)
{
	if (tracker_id >= MAX_TRACKERS) {
		return;
	}
	unsigned int key = irq_lock();
	if (dc_target_tracker_id == tracker_id) {
		dc_active = false;
		dc_target_tracker_id = UINT8_MAX;
	}
	dc_batch_mask &= ~BIT(tracker_id);
	dc_batch_active = dc_batch_mask != 0;
	/* CDC frames share one byte ring; discard queued old-slot frames. */
	dc_discard_buffer();
	irq_unlock(key);
}

bool data_collect_is_active(void)
{
	return dc_active;
}

uint8_t data_collect_get_target_id(void)
{
	return dc_target_tracker_id;
}

bool data_collect_batch_is_active(void)
{
	return dc_batch_active;
}

bool data_collect_batch_is_target(uint8_t tracker_id)
{
	return dc_batch_active && tracker_id < MAX_TRACKERS && (dc_batch_mask & BIT(tracker_id)) != 0;
}

bool data_collect_is_target(uint8_t tracker_id)
{
	return dc_active && tracker_id == dc_target_tracker_id;
}

void data_collect_write(const uint8_t *data, uint8_t len, uint8_t rssi)
{
	if (!cdc_ready) return;

	dc_last_rx_time = k_uptime_get();

	/* Frame: [0xAA][0x55][length][payload...][rssi][rx_ticks(4)][CRC-8]
	 * Total overhead: 2 sync + 1 len + 1 rssi + 4 ticks + 1 crc = 9 bytes */
	uint32_t frame_size = 2 + 1 + len + 1 + 4 + 1;

	if (buf_free() < frame_size) {
		dc_frames_dropped++;
		return;
	}

	uint32_t rx_ticks = (uint32_t)k_uptime_ticks();

	/* Write sync marker */
	buf_put(0xAA);
	buf_put(0x55);

	/* Length byte (payload + rssi + ticks = len + 5) */
	uint8_t frame_len = len + 5;
	buf_put(frame_len);

	/* Payload (raw ESB data) */
	uint8_t crc = 0x07;
	crc = crc8_ccitt(crc, &frame_len, 1);
	for (uint8_t i = 0; i < len; i++) {
		buf_put(data[i]);
	}
	crc = crc8_ccitt(crc, data, len);

	/* RSSI */
	buf_put(rssi);
	crc = crc8_ccitt(crc, &rssi, 1);

	/* Receiver timestamp (big-endian) */
	uint8_t ticks_buf[4];
	sys_put_be32(rx_ticks, ticks_buf);
	for (int i = 0; i < 4; i++) {
		buf_put(ticks_buf[i]);
	}
	crc = crc8_ccitt(crc, ticks_buf, 4);

	/* CRC */
	buf_put(crc);

	dc_frames_sent++;

	k_work_schedule(&dc_tx_kick_work, K_NO_WAIT);
}
```

## src/data_collect.h
```c
/*
	SlimeVR Code is placed under the MIT license
	Copyright (c) 2025 SlimeVR Contributors

	Permission is hereby granted, free of charge, to any person obtaining a copy
	of this software and associated documentation files (the "Software"), to deal
	in the Software without restriction, including without limitation the rights
	to use, copy, modify, merge, publish, distribute, sublicense, and/or sell
	copies of the Software, and to permit persons to whom the Software is
	furnished to do so, subject to the following conditions:

	The above copyright notice and this permission notice shall be included in
	all copies or substantial portions of the Software.

	THE SOFTWARE IS PROVIDED "AS IS", WITHOUT WARRANTY OF ANY KIND, EXPRESS OR
	IMPLIED, INCLUDING BUT NOT LIMITED TO THE WARRANTIES OF MERCHANTABILITY,
	FITNESS FOR A PARTICULAR PURPOSE AND NONINFRINGEMENT. IN NO EVENT SHALL THE
	AUTHORS OR COPYRIGHT HOLDERS BE LIABLE FOR ANY CLAIM, DAMAGES OR OTHER
	LIABILITY, WHETHER IN AN ACTION OF CONTRACT, TORT OR OTHERWISE, ARISING FROM,
	OUT OF OR IN CONNECTION WITH THE SOFTWARE OR THE USE OR OTHER DEALINGS IN
	THE SOFTWARE.
*/
#ifndef SLIMENRF_DATA_COLLECT_H
#define SLIMENRF_DATA_COLLECT_H

#include <stdint.h>
#include <stdbool.h>

#ifdef CONFIG_DATA_COLLECT

/* Clears single and batch session state.
 * CDC initializes once in usb_init_thread before USB setup. HID uses SYS_INIT.
 * Opening the console does not reinitialize either backend. */
int data_collect_init(void);

/* Write a raw data packet.
 * Called from ESB event handler when a raw packet arrives.
 * data: raw ESB payload, len: payload length, rssi: received signal strength */
void data_collect_write(const uint8_t *data, uint8_t len, uint8_t rssi);

/* Runtime control: start/stop data collection for a specific tracker */
void data_collect_start(uint8_t tracker_id);
void data_collect_stop(void);
void data_collect_forget_tracker(uint8_t tracker_id);
bool data_collect_is_active(void);
uint8_t data_collect_get_target_id(void);

/* Runtime control for simultaneous raw collection from selected trackers. */
void data_collect_batch_start(uint32_t mask, uint16_t rate_hz);
void data_collect_batch_stop(void);
#if defined(CONFIG_DATA_COLLECT_HID)
/* Radio-ISR admission: true only after an immutable copy is queued. False
 * means retry later, not an accepted/dropped report. Caller validates F04. */
bool data_collect_capture_accept(const uint8_t *data, uint8_t len, uint8_t rssi);
/* Schedule USB after the radio ACK deadline, from event/timer context. */
void data_collect_capture_kick(void);
uint32_t data_collect_batch_request_stop(void);
void data_collect_batch_confirm_stop(uint8_t tracker);
#else
static inline void data_collect_batch_confirm_stop(uint8_t tracker) { (void)tracker; }
#endif
bool data_collect_batch_is_active(void);
bool data_collect_batch_is_target(uint8_t tracker_id);

/* Check if data collection is active and this tracker is the target */
bool data_collect_is_target(uint8_t tracker_id);
#else /* !CONFIG_DATA_COLLECT */

static inline int data_collect_init(void) { return 0; }
static inline void data_collect_write(const uint8_t *data, uint8_t len, uint8_t rssi) { (void)data; (void)len; (void)rssi; }
static inline void data_collect_start(uint8_t tracker_id) { (void)tracker_id; }
static inline void data_collect_stop(void) {}
static inline void data_collect_forget_tracker(uint8_t tracker_id) { (void)tracker_id; }
static inline bool data_collect_is_active(void) { return false; }
static inline uint8_t data_collect_get_target_id(void) { return 0; }
static inline void data_collect_batch_start(uint32_t mask, uint16_t rate_hz) { (void)mask; (void)rate_hz; }
static inline void data_collect_batch_stop(void) {}
static inline void data_collect_batch_confirm_stop(uint8_t tracker) { (void)tracker; }
static inline bool data_collect_batch_is_active(void) { return false; }
static inline bool data_collect_batch_is_target(uint8_t tracker_id) { (void)tracker_id; return false; }
static inline bool data_collect_is_target(uint8_t tracker_id) { (void)tracker_id; return false; }
#endif /* CONFIG_DATA_COLLECT */

#endif /* SLIMENRF_DATA_COLLECT_H */
```

## src/esb_ota.h
```c
/*
	SlimeVR Code is placed under the MIT license
	Copyright (c) 2025 SlimeVR Contributors

	Permission is hereby granted, free of charge, to any person obtaining a copy
	of this software and associated documentation files (the "Software"), to deal
	in the Software without restriction, including without limitation the rights
	to use, copy, modify, merge, publish, distribute, sublicense, and/or sell
	copies of the Software, and to permit persons to whom the Software is
	furnished to do so, subject to the following conditions:

	The above copyright notice and this permission notice shall be included in
	all copies or substantial portions of the Software.

	THE SOFTWARE IS PROVIDED "AS IS", WITHOUT WARRANTY OF ANY KIND, EXPRESS OR
	IMPLIED, INCLUDING BUT NOT LIMITED TO THE WARRANTIES OF MERCHANTABILITY,
	FITNESS FOR A PARTICULAR PURPOSE AND NONINFRINGEMENT. IN NO EVENT SHALL THE
	AUTHORS OR COPYRIGHT HOLDERS BE LIABLE FOR ANY CLAIM, DAMAGES OR OTHER
	LIABILITY, WHETHER IN AN ACTION OF CONTRACT, TORT OR OTHERWISE, ARISING FROM,
	OUT OF OR IN CONNECTION WITH THE SOFTWARE OR THE USE OR OTHER DEALINGS IN
	THE SOFTWARE.
*/
#ifndef SLIMENRF_ESB_OTA_RECEIVER_H
#define SLIMENRF_ESB_OTA_RECEIVER_H

#include <stdint.h>
#include <stdbool.h>
#include "connection/esb.h"

/*
 * ESB OTA Protocol Constants (shared with tracker)
 */
#define OTA_DATA_HEADER_SIZE    4
#define OTA_DATA_MAX_PAYLOAD    44

#define OTA_STATUS_IDLE             0x00
#define OTA_STATUS_READY            0x01
#define OTA_STATUS_RECEIVING        0x02
#define OTA_STATUS_VERIFY_OK        0x03
#define OTA_STATUS_VERIFY_FAIL      0x04
#define OTA_STATUS_ACTIVATING       0x05
#define OTA_STATUS_COMPLETE         0x06
#define OTA_STATUS_ERROR            0x10
#define OTA_STATUS_BOARD_MISMATCH   0x11
#define OTA_STATUS_FLASH_ERROR      0x12
#define OTA_STATUS_SIZE_ERROR       0x13
#define OTA_STATUS_SEQ_ERROR        0x14
#define OTA_STATUS_TIMEOUT          0x15

#define OTA_PROTOCOL_VERSION    2
#define OTA_BOARD_TARGET_MAX    48
#define OTA_BEGIN_PACKET_SIZE   48
#define OTA_FW_INFO_PACKET_SIZE 66

#define OTA_BOOTLOADER_NONE          0
#define OTA_BOOTLOADER_ADAFRUIT_UF2  1
#define OTA_BOOTLOADER_NRF5_OPENDFU  2
#define OTA_BOOTLOADER_MCUBOOT       3

/* HID OTA report types (PC ↔ Receiver) */
#define HID_OTA_QUERY_INFO      0xF0
#define HID_OTA_FW_INFO         0xF1
#define HID_OTA_BEGIN           0xF2
#define HID_OTA_DATA            0xF3
#define HID_OTA_STATUS          0xF4
#define HID_OTA_VERIFY          0xF5
#define HID_OTA_ACTIVATE        0xF6
#define HID_OTA_ABORT           0xF7

/*
 * Seq-indexed ring buffer for OTA data packets (HID → ESB ACK).
 * Must be power of 2. Indexed by seq number: ring[seq & MASK].
 * 128 packets × 64 bytes = 8 KB (shared by all targets).
 * Retransmission is automatic: tracker's next_seq indexes the buffer.
 */
#define OTA_TX_RING_SIZE        128
#define OTA_TX_RING_MASK        (OTA_TX_RING_SIZE - 1)

/* Maximum number of trackers updated in parallel */
#define OTA_MAX_PARALLEL        4

/**
 * Check if an OTA session is active for any tracker.
 * ISR-safe. Uses a short spinlock and does not sleep.
 */
bool esb_ota_relay_is_active(void);

/**
 * Check if a specific tracker is participating in the current OTA session.
 */
bool esb_ota_relay_is_target(uint8_t tracker_id);

/** Return true while an OTA abort tombstone remains active for a tracker. */
bool esb_ota_relay_abort_pending(uint8_t tracker_id);

/* Thread context, before a roster slot is removed/reused. */
void esb_ota_forget_tracker(uint8_t tracker_id);

/**
 * Process a HID OUT report that may contain an OTA command.
 * Called from HID read work handler (thread context).
 *
 * @param data   HID report data (64 bytes)
 * @param len    Report length
 */
void esb_ota_relay_process_hid(const uint8_t *data, size_t len);

/**
 * Called from esb_ack_handler_cb (radio ISR context) when a tracker
 * in OTA mode sends a status/poll packet. Fills the ACK payload
 * with the OTA data packet matching the tracker's next_seq.
 *
 * Uses seq-indexed lookup: the tracker's next_seq from the STATUS
 * packet directly indexes the ring buffer. If the ACK is lost,
 * the tracker re-sends the same next_seq and gets automatic
 * retransmission without PC intervention.
 *
 * @param tracker_id   The tracker that sent the poll
 * @param pipe_id      ESB pipe
 * @param ack_payload  ACK payload to fill
 * @param has_ack      Set to true if ACK payload was filled
 * @param rx_data      Received packet data (STATUS), or NULL
 * @param rx_len       Length of rx_data
 */
void esb_ota_relay_fill_ack(uint8_t tracker_id, uint32_t pipe_id,
			    struct esb_payload *ack_payload, bool *has_ack,
			    const uint8_t *rx_data, uint8_t rx_len);

/**
 * Called from event_handler (EVENT IRQ context) when the receiver
 * receives an OTA status or firmware info packet from a tracker.
 * Forwards it to PC via HID IN report.
 *
 * @param data   Received ESB packet data
 * @param len    Packet length
 */
void esb_ota_relay_process_tracker_packet(const uint8_t *data, size_t len);

/**
 * Process OTA commands from the console.
 * Called from console thread.
 */
void esb_ota_relay_console_cmd(uint8_t tracker_id, const char *cmd);

#endif /* SLIMENRF_ESB_OTA_RECEIVER_H */
```
